## lib/actuate/Kconfig
```kconfig
# Copyright (c) 2023 CogniPilot Foundation
# SPDX-License-Identifier: Apache-2.0

menu "Actuate"

rsource "pwm/Kconfig"
rsource "led_array/Kconfig"
rsource "sound/Kconfig"

endmenu
```

## lib/sense/Kconfig
```kconfig
# Copyright (c) 2023 CogniPilot Foundation
# SPDX-License-Identifier: Apache-2.0

menu "Sense"

rsource "imu/Kconfig"

endmenu
```

## lib/synapse/Kconfig
```kconfig
# Copyright (c) 2023 CogniPilot Foundation
# SPDX-License-Identifier: Apache-2.0

menu "Synapse"

rsource "zros/Kconfig"
rsource "eth_tx/Kconfig"
rsource "eth_rx/Kconfig"
rsource "topic/Kconfig"

endmenu
```
