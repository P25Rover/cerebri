## CMakeLists.txt
```
#-------------------------------------------------------------------------------
# Zephyr Cerebri Application
#
# Copyright (c) 2023 CogniPilot Foundation
# SPDX-License-Identifier: Apache-2.0

cmake_minimum_required(VERSION 3.13.1)

if (${BOARD} STREQUAL "mr_canhubk3")
    message(STATUS "enabling mr_canhubk3_adap shield")
    set(SHIELD mr_canhubk3_adap)
endif ()

find_package(Zephyr REQUIRED HINTS $ENV{ZEPHYR_BASE})

project(. LANGUAGES C)

set(SOURCE_FILES src/main.c)

list(APPEND SOURCE_FILES src/fsm.c)
list(APPEND SOURCE_FILES src/mixing.c)
list(APPEND SOURCE_FILES src/manual.c)
list(APPEND SOURCE_FILES src/auto.c)
list(APPEND SOURCE_FILES src/movement.c)
list(APPEND SOURCE_FILES src/lighting.c)

list(APPEND SOURCE_FILES
        src/casadi/gen/b3rb.c)

set(flags
        -std=c11
        -Wall
        -Wextra
        -Werror
        -Wstrict-prototypes
        -Waggregate-return
        -Wbad-function-cast
        -Wcast-align
        -Wcast-qual
        -Wfloat-equal
        -Wformat-security
        -Wlogical-op
        -Wmissing-declarations
        # ubxlib includes geographiclib which dir doesn't exist
        #-Wmissing-include-dirs
        -Wmissing-prototypes
        -Wnested-externs
        -Wpointer-arith
        -Wredundant-decls
        -Wsequence-point
        -Wshadow
        -Wstrict-prototypes
        -Wswitch
        -Wundef
        -Wunreachable-code
        -Wunused-but-set-parameter
        -Wwrite-strings
)
string(JOIN " " flags ${flags})

set_source_files_properties(
        ${SOURCE_FILES}
        PROPERTIES COMPILE_FLAGS
        "${flags}"
)

set_source_files_properties(
        src/casadi/gen/b3rb.c
        PROPERTIES COMPILE_FLAGS
        "${flags}\
  -Wno-unused-parameter\
  -Wno-missing-prototypes\
  -Wno-missing-declarations\
  -Wno-float-equal")

target_sources(app PRIVATE ${SOURCE_FILES})

target_include_directories(app SYSTEM BEFORE PRIVATE ${ZEPHYR_BASE}/include)

# vi: ts=2 sw=2 et
```

## Kconfig
```
# Copyright (c) 2023, CogniPilot Foundation
# SPDX-License-Identifier: Apache-2.0

mainmenu "CogniPilot - Cerebri - B3RB"
source "Kconfig.zephyr"

config CEREBRI_B3RB_FSM
  bool "enable finite state machine"
  help
    Enable fintie state machine

config CEREBRI_B3RB_CASADI
  bool "enable casadi code"
  help
    Enable Casadi generated code

config CEREBRI_B3RB_BATTERY_MIN_MILLIVOLT
  int "min battery voltage in milli volts before shut off"
  default 10000
  help
    Minimum battery voltage in mV before auto-disarm

config CEREBRI_B3RB_BATTERY_LOW_MILLIVOLT
  int "low battery voltage in milli volts before warning"
  default 10500
  help
    Low battery voltage in mV before warning

config CEREBRI_B3RB_BATTERY_MAX_MILLIVOLT
  int "max battery voltage in milli volts"
  default 12600
  help
    Maximum battery voltage

config CEREBRI_B3RB_GAIN_HEADING
  int "heading gain"
  default 100
  help
    Steering = Heading error * GAIN_/ 1000

config CEREBRI_B3RB_GAIN_CROSS_TRACK
  int "cross track gain"
  default 100
  help
    Steering = Cross track error * GAIN / 1000

config CEREBRI_B3RB_GAIN_ALONG_TRACK
  int "along track gain"
  default 100
  help
    Steering = Along track error * GAIN / 1000

config CEREBRI_B3RB_MAX_TURN_ANGLE_MRAD
  int "max turn angle mrad"
  default 400
  help
    Max turn angle in milli-radians

config CEREBRI_B3RB_MAX_VELOCITY_MM_S
  int "max velocity, mm/s"
  default 1000
  help
    Max velocity in mm/s

config CEREBRI_B3RB_WHEEL_RADIUS_MM
  int "wheel radius, mm"
  default 37
  help
    Wheel radius in mm

config CEREBRI_B3RB_WHEEL_BASE_MM
  int "wheel base, mm"
  default 226
  help
    Wheel radius in mm

module = CEREBRI_B3RB
module-str = cerebri_b3rb
source "subsys/logging/Kconfig.template.log_config"
```

## prj.conf
```kconfig
CONFIG_CEREBRI_APP_NAME="b3rb"

CONFIG_SYS_CLOCK_TICKS_PER_SEC=10000
CONFIG_TICKLESS_KERNEL=n

CONFIG_CEREBRI_ACTUATE_PWM=y
CONFIG_CEREBRI_ACTUATE_LED_ARRAY=y
CONFIG_CEREBRI_ACTUATE_SOUND=y

CONFIG_NET_BUF_RX_COUNT=24
CONFIG_NET_PKT_RX_COUNT=24

CONFIG_CEREBRI_SENSE_IMU=y

CONFIG_CEREBRI_SYNAPSE_ETH_RX=y
CONFIG_CEREBRI_SYNAPSE_ETH_TX=y
CONFIG_CEREBRI_SYNAPSE_TOPIC=y
CONFIG_CEREBRI_SYNAPSE_ZROS=y

CONFIG_CEREBRI_CORE_COMMON=y
CONFIG_CEREBRI_CORE_COMMON_BOOT_BANNER=y

CONFIG_SHELL_STACK_SIZE=10240
CONFIG_INIT_STACKS=y

CONFIG_LOG=y
CONFIG_LOG_CMDS=y
CONFIG_LOG_MODE_DEFERRED=y

CONFIG_ASSERT=y
CONFIG_TEST=y
CONFIG_CBPRINTF_FP_SUPPORT=y

# modules
CONFIG_SYNAPSE_PROTOBUF=y
CONFIG_SYNAPSE_TINYFRAME=y
CONFIG_NANOPB=y
CONFIG_UBXLIB=y

# Debug
CONFIG_CEREBRI_SENSE_IMU_LOG_LEVEL_DBG=n

# General config
CONFIG_POSIX_API=y
CONFIG_NEWLIB_LIBC=y
CONFIG_MAIN_THREAD_PRIORITY=5
CONFIG_SYSTEM_WORKQUEUE_PRIORITY=-2
CONFIG_SYS_CLOCK_TICKS_PER_SEC=10000
# Networking config
CONFIG_NET_SHELL=y
CONFIG_NETWORKING=y
CONFIG_NET_IPV4=y
CONFIG_NET_IPV6=n
CONFIG_NET_TCP=y
CONFIG_NET_SOCKETS=y

# Network address config
CONFIG_NET_CONFIG_SETTINGS=y
CONFIG_NET_STATISTICS=y
CONFIG_NET_MGMT_EVENT_INFO=y
CONFIG_NET_MGMT_EVENT_MONITOR=y
CONFIG_NET_BUF_POOL_USAGE=y
CONFIG_NET_DEBUG_NET_PKT_ALLOC=y
CONFIG_NET_CONFIG_NEED_IPV4=y
CONFIG_NET_CONFIG_MY_IPV4_ADDR="192.0.2.1"
CONFIG_NET_CONFIG_PEER_IPV4_ADDR="192.0.2.2"

# STATS
CONFIG_THREAD_RUNTIME_STATS=y
CONFIG_SCHED_THREAD_USAGE=y
CONFIG_SCHED_THREAD_USAGE_ANALYSIS=y
CONFIG_SCHED_THREAD_USAGE_ALL=y
CONFIG_SCHED_THREAD_USAGE_AUTO_ENABLE=y
```

## boards/native_sim.conf
```kconfig
CONFIG_ETH_NATIVE_POSIX=y
CONFIG_TEST_RANDOM_GENERATOR=y
CONFIG_SYS_CLOCK_TICKS_PER_SEC=200
CONFIG_NATIVE_POSIX_SLOWDOWN_TO_REAL_TIME=n

CONFIG_NO_OPTIMIZATIONS=y
CONFIG_NATIVE_UART_0_ON_STDINOUT=y
CONFIG_NATIVE_UART_AUTOATTACH_DEFAULT_CMD="xterm -fa Monospcae -fs 12 -fg grey -bg black -T cerebri-shell -e screen %s &"

CONFIG_CEREBRI_BOOT_BANNER=n
CONFIG_UBXLIB=n

CONFIG_ASAN=n
CONFIG_UBSAN=n

CONFIG_CEREBRI_ACTUATE_LED_ARRAY=n
CONFIG_CEREBRI_ACTUATE_SOUND=n
CONFIG_CEREBRI_ACTUATE_PWM=n

CONFIG_CEREBRI_SENSE_IMU=n

CONFIG_NEWLIB_LIBC=n
CONFIG_EXTERNAL_LIBC=y
CONFIG_POSIX_API=n
```

## src/auto.c
```c
//
//    Created by Enzo Le Van
//    Ce code reprend la structure du noeud "manual" mais au lieu de suivre le joystick, il suit la commande
//    obtenue à partir du noeud "vision" de la NavQ
//

#include <zephyr/kernel.h>
#include <zephyr/logging/log.h>

#include <zros/private/zros_node_struct.h>
#include <zros/private/zros_pub_struct.h>
#include <zros/private/zros_sub_struct.h>
#include <zros/zros_node.h>
#include <zros/zros_pub.h>
#include <zros/zros_sub.h>

#include <synapse_topic_list.h>

#include "mixing.h"

#define MY_STACK_SIZE 1024
#define MY_PRIORITY 4

LOG_MODULE_REGISTER(b3rb_auto, CONFIG_CEREBRI_B3RB_LOG_LEVEL);

typedef struct _context {
    struct zros_node node;

    struct zros_sub sub_road_curve_angle;
    struct zros_pub pub_actuators;

    synapse_msgs_RoadCurveAngle road_curve_angle;
    synapse_msgs_Actuators actuators;

    const double wheel_radius;
    const double max_turn_angle;
    const double max_velocity;
} context;

static context g_ctx = {
    .node = {},

    .sub_road_curve_angle = {},
    .pub_actuators = {},

    .road_curve_angle = synapse_msgs_RoadCurveAngle_init_default,
    .actuators = synapse_msgs_Actuators_init_default,

    .wheel_radius = CONFIG_CEREBRI_B3RB_WHEEL_RADIUS_MM / 1000.0,
    .max_turn_angle = CONFIG_CEREBRI_B3RB_MAX_TURN_ANGLE_MRAD / 1000.0,
    .max_velocity = CONFIG_CEREBRI_B3RB_MAX_VELOCITY_MM_S / 1000.0,
};

static void init(context* ctx)
{
    zros_node_init(&ctx->node, "b3rb_auto");
    zros_sub_init(&ctx->sub_road_curve_angle, &ctx->node, &topic_road_curve_angle, &ctx->road_curve_angle, 10);
    zros_pub_init(&ctx->pub_actuators, &ctx->node, &topic_actuators_auto, &ctx->actuators);
}

static double compute_velocity (context* ctx, double angle) {
    ARG_UNUSED(angle);

    return ctx->max_velocity / 2;
}

static void b3rb_auto_entry_point(void* p0, void* p1, void* p2)
{
    LOG_INF("init");
    context* ctx = p0;
    ARG_UNUSED(p1);
    ARG_UNUSED(p2);

    init(ctx);

    struct k_poll_event events[] = {
        *zros_sub_get_event(&ctx->sub_road_curve_angle),
    };

    while (true) {
        k_poll(events, ARRAY_SIZE(events), K_MSEC(1000));

        if (zros_sub_update_available(&ctx->sub_road_curve_angle)) {
            zros_sub_update(&ctx->sub_road_curve_angle);
        }

        /*
            Compute actuator knowing road curve angle
        */

        double turn_angle = 0;
        double road_curve_angle = ctx->road_curve_angle.angle;

        if (road_curve_angle > ctx->max_turn_angle) {
            turn_angle = ctx->max_turn_angle;
        } else if (road_curve_angle < -ctx->max_turn_angle) {
            turn_angle = -ctx->max_turn_angle;
        } else {
            turn_angle = road_curve_angle;
        }

        double omega_fwd = compute_velocity (ctx, turn_angle);

        b3rb_set_actuators(&ctx->actuators, turn_angle, omega_fwd);

        zros_pub_update(&ctx->pub_actuators);
    }
}

K_THREAD_DEFINE(b3rb_auto, MY_STACK_SIZE,
    b3rb_auto_entry_point, (void*)&g_ctx, NULL, NULL,
    MY_PRIORITY, 0, 1000);

/* vi: ts=4 sw=4 et */
```

## src/fsm.c
```c
/*
 * Copyright CogniPilot Foundation 2023
 * SPDX-License-Identifier: Apache-2.0

	Ce node ZROS est relié à l'interface de contrôle via le topic "JOY" (pour "JOYSTICK"). 
 */

#include <stdio.h>
#include <zephyr/kernel.h>
#include <zephyr/logging/log.h>

#include <zros/private/zros_node_struct.h>
#include <zros/private/zros_pub_struct.h>
#include <zros/private/zros_sub_struct.h>
#include <zros/zros_node.h>
#include <zros/zros_pub.h>
#include <zros/zros_sub.h>

#include <synapse_topic_list.h>

#define MY_STACK_SIZE 3072
#define MY_PRIORITY 4
#define STATE_ANY -1

LOG_MODULE_REGISTER(b3rb_fsm, CONFIG_CEREBRI_B3RB_LOG_LEVEL);

static void transition(
    void* state,
    bool request,
    const char* request_name,
    int pre,
    uint8_t post,
    char* buf,
    size_t n,
    int* request_seq,
    bool* request_rejected,
    size_t n_guards,
    ...)
{
    uint8_t* state_int = (uint8_t*)state;

    // not requested
    if (!request) {
        return;
    }

    // null transition
    if (*state_int == post) {
        return;
    }

    // LOG_INF("%s pre: %d, post: %d, state: %d", request_name, pre, post, *state_int);
    // pre state required and not matched
    if (pre >= 0 && *state_int != pre) {
        return;
    }

    // new valid request
    (*request_seq)++;

    // check guards
    va_list ap;
    va_start(ap, n_guards);
    for (size_t i = 0; i < n_guards; i++) {
        int guard = va_arg(ap, int);
        const char* guard_txt = va_arg(ap, const char*);
        if (guard) {
            snprintf(buf, n, "deny %s: %s", request_name, guard_txt);
            LOG_WRN("%s", buf);
            *request_rejected = true;
            return;
        }
    }
    va_end(ap);
    snprintf(buf, n, "accept %s", request_name);
    LOG_INF("%s", buf);
    *state_int = post;
    *request_rejected = false;
    return;
}

typedef struct status_input_s {
    bool request_arm;
    bool request_disarm;
    bool request_manual;
    bool request_auto;
    bool request_cmd_vel;
    bool request_calibration;
    bool safe;
    bool mode_set;
    bool fuel_low;
    bool fuel_critical;
} status_input_t;

typedef struct _context {
    struct zros_node node;
    synapse_msgs_Joy joy;
    synapse_msgs_Status status;
    status_input_t status_input;
    struct zros_sub sub_joy;
    struct zros_pub pub_status;
} context;

static context g_ctx = {
    .node = {},
    .joy = synapse_msgs_Joy_init_default,
    .status = {
        .has_header = true,
        .header = {
            .frame_id = "base_link",
            .has_stamp = true,
            .seq = 0,
            .stamp = synapse_msgs_Time_init_default,
        },
        .arming = synapse_msgs_Status_Arming_ARMING_DISARMED,
        .fuel = synapse_msgs_Status_Fuel_FUEL_UNKNOWN,
        .fuel_percentage = 0,
        .joy = synapse_msgs_Status_Joy_JOY_UNKNOWN,
        .mode = synapse_msgs_Status_Mode_MODE_UNKNOWN,
        .power = 0.0,
        .status_message = "",
    },
    .sub_joy = {},
    .pub_status = {},
};

static void b3rb_fsm_init(context* ctx)
{
    zros_node_init(&ctx->node, "b3rb_fsm");
    zros_sub_init(&ctx->sub_joy, &ctx->node, &topic_joy, &ctx->joy, 10);
    zros_pub_init(&ctx->pub_status, &ctx->node, &topic_status, &ctx->status);
}

static void fsm_compute_input(status_input_t* input, const context* ctx)
{
    input->request_arm = ctx->joy.buttons[JOY_BUTTON_ARM] == 1;
    input->request_disarm = ctx->joy.buttons[JOY_BUTTON_DISARM] == 1;
    input->request_manual = ctx->joy.buttons[JOY_BUTTON_MANUAL] == 1;
    input->request_auto = ctx->joy.buttons[JOY_BUTTON_AUTO] == 1;
    input->request_cmd_vel = ctx->joy.buttons[JOY_BUTTON_CMD_VEL] == 1;
    input->request_calibration = ctx->joy.buttons[JOY_BUTTON_CALIBRATION] == 1;
    input->mode_set = ctx->status.mode != synapse_msgs_Status_Mode_MODE_UNKNOWN;
}

static void fsm_update(synapse_msgs_Status* status, const status_input_t* input)
{
    // arm transition
    transition(
        &status->arming, // state
        input->request_arm, // request
        "request arm", // label
        synapse_msgs_Status_Arming_ARMING_DISARMED, // pre
        synapse_msgs_Status_Arming_ARMING_ARMED, // post
        status->status_message, sizeof(status->status_message), // status
        &status->request_seq, &status->request_rejected, // request
        // guards
        5,
        status->mode == synapse_msgs_Status_Mode_MODE_UNKNOWN, "mode not set",
        status->mode == synapse_msgs_Status_Mode_MODE_CALIBRATION, "mode calibration",
        input->safe, "safety on",
        input->fuel_critical, "fuel_critical",
        input->fuel_low, "fuel_low");

    // disarm transitions
    transition(
        &status->arming, // state
        input->request_disarm, // request
        "request disarm", // label
        synapse_msgs_Status_Arming_ARMING_ARMED, // pre
        synapse_msgs_Status_Arming_ARMING_DISARMED, // post
        status->status_message, sizeof(status->status_message), // status
        &status->request_seq, &status->request_rejected, // request
        0); // guards

    // mode transitions
    transition(
        &status->mode, // state
        input->request_manual, // request
        "request mode manual", // label
        STATE_ANY, // pre
        synapse_msgs_Status_Mode_MODE_MANUAL, // post
        status->status_message, sizeof(status->status_message), // status
        &status->request_seq, &status->request_rejected, // request
        0); // guards

    transition(
        &status->mode, // state
        input->request_cmd_vel, // request
        "request mode cmd_vel", // label
        STATE_ANY, // pre
        synapse_msgs_Status_Mode_MODE_CMD_VEL, // post
        status->status_message, sizeof(status->status_message), // status
        &status->request_seq, &status->request_rejected, // request
        0); // guards
        
    transition(
        &status->mode, // state
        input->request_auto, // request
        "request mode auto", // label
        STATE_ANY, // pre
        synapse_msgs_Status_Mode_MODE_AUTO, // post
        status->status_message, sizeof(status->status_message), // status
        &status->request_seq, &status->request_rejected, // request
        0); // guards

    transition(
        &status->mode, // state
        input->request_calibration, // request
        "request mode calibration", // label
        STATE_ANY, // pre
        synapse_msgs_Status_Mode_MODE_CALIBRATION, // post
        status->status_message, sizeof(status->status_message), // status
        &status->request_seq, &status->request_rejected, // request
        // guards
        1,
        status->arming == synapse_msgs_Status_Arming_ARMING_ARMED, "disarm required");

    // set timestamp
    stamp_header(&status->header, k_uptime_ticks());
    status->header.seq++;
}

static void status_add_extra_info(synapse_msgs_Status* status, status_input_t* input)
{
    if (input->fuel_critical) {
        status->fuel = synapse_msgs_Status_Fuel_FUEL_CRITICAL;
    } else if (input->fuel_low) {
        status->fuel = synapse_msgs_Status_Fuel_FUEL_LOW;
    } else {
        status->fuel = synapse_msgs_Status_Fuel_FUEL_NOMINAL;
    }
}

static void b3rb_fsm_entry_point(void* p0, void* p1, void* p2)
{
    LOG_INF("initializing b3rb_fsm");
    context* ctx = p0;
    ARG_UNUSED(p1);
    ARG_UNUSED(p2);

    b3rb_fsm_init(ctx);

    struct k_poll_event events[] = {
        *zros_sub_get_event(&ctx->sub_joy),
    };

    int64_t joy_last_ticks = k_uptime_ticks();
    int64_t joy_loss_ticks = 1.0 * CONFIG_SYS_CLOCK_TICKS_PER_SEC;

    while (true) {

        // current ticks
        int64_t now_ticks = k_uptime_ticks();

        // wait for input event, publish at 1 Hz regardless
        int rc = 0;
        rc = k_poll(events, ARRAY_SIZE(events), K_MSEC(1000));
        if (rc != 0) {
            LOG_DBG("fsm joy/battery polling timeout");
        }

        if (zros_sub_update_available(&ctx->sub_joy)) {
            zros_sub_update(&ctx->sub_joy);
            if (ctx->status.joy == synapse_msgs_Status_Joy_JOY_LOSS) {
                LOG_WRN("joy regained");
            }
            joy_last_ticks = now_ticks;
            ctx->status.joy = synapse_msgs_Status_Joy_JOY_NOMINAL;
        }

        // check for joy loss
        if (ctx->status.joy != synapse_msgs_Status_Joy_JOY_LOSS
            && now_ticks - joy_last_ticks > joy_loss_ticks) {
            LOG_WRN("joy loss");
            ctx->status.joy = synapse_msgs_Status_Joy_JOY_LOSS;
        }

        // perform processing
        fsm_compute_input(&ctx->status_input, ctx);
        fsm_update(&ctx->status, &ctx->status_input);
        status_add_extra_info(&ctx->status, &ctx->status_input);
        zros_pub_update(&ctx->pub_status);
    }
}

K_THREAD_DEFINE(b3rb_fsm, MY_STACK_SIZE,
    b3rb_fsm_entry_point, &g_ctx, NULL, NULL,
    MY_PRIORITY, 0, 1000);

/* vi: ts=4 sw=4 et */
```

## src/lighting.c
```c
/*
 * Copyright CogniPilot Foundation 2023
 * SPDX-License-Identifier: Apache-2.0
 */

#include <math.h>

#include <zephyr/kernel.h>
#include <zephyr/logging/log.h>

#include <zros/private/zros_node_struct.h>
#include <zros/private/zros_pub_struct.h>
#include <zros/private/zros_sub_struct.h>
#include <zros/zros_node.h>
#include <zros/zros_pub.h>
#include <zros/zros_sub.h>

#include <synapse_topic_list.h>

#define MY_STACK_SIZE 2048
#define MY_PRIORITY 4

LOG_MODULE_REGISTER(b3rb_lighting, CONFIG_CEREBRI_B3RB_LOG_LEVEL);

extern struct k_work_q g_low_priority_work_q;
static void lighting_work_handler(struct k_work* work);
static void lighting_timer_handler(struct k_timer* dummy);

typedef struct context_ {
    // work
    struct k_work work_item;
    struct k_timer timer;
    // node
    struct zros_node node;
    // data
    synapse_msgs_Status status;
    synapse_msgs_LEDArray led_array;
    synapse_msgs_Joy joy;
    // subscriptions
    struct zros_sub sub_status, sub_joy;
    // publications
    struct zros_pub pub_led_array;
    bool lights_on;
} context_t;

static context_t g_ctx = {
    .work_item = Z_WORK_INITIALIZER(lighting_work_handler),
    .timer = Z_TIMER_INITIALIZER(g_ctx.timer, lighting_timer_handler, NULL),
    .status = synapse_msgs_Status_init_default,
    .led_array = synapse_msgs_LEDArray_init_default,
    .sub_status = {},
    .sub_joy = {},
    .pub_led_array = {},
    .node = {},
    .lights_on = false,
};

static void lighting_init(context_t* ctx)
{
    zros_node_init(&ctx->node, "b3rb_lighting");
    zros_sub_init(&ctx->sub_status, &ctx->node, &topic_status, &ctx->status, 10);
    zros_sub_init(&ctx->sub_joy, &ctx->node, &topic_joy, &ctx->joy, 10);
    zros_pub_init(&ctx->pub_led_array, &ctx->node, &topic_led_array, &ctx->led_array);
}

static void set_led(const int index, const double* color, const double brightness, synapse_msgs_LED* led)
{
    led->index = index;
    led->r = brightness * color[0];
    led->g = brightness * color[1];
    led->b = brightness * color[2];
}

static void lighting_work_handler(struct k_work* work)
{
    context_t* ctx = CONTAINER_OF(work, context_t, work_item);

    // update subscriptions
    zros_sub_update(&ctx->sub_status);
    zros_sub_update(&ctx->sub_joy);

    double t = k_uptime_ticks() / ((double)CONFIG_SYS_CLOCK_TICKS_PER_SEC);
    const double led_pulse_freq = 0.25;
    const double brightness_min = 4;
    const double brightness_max = 30;
    const double brightness_amplitude = (brightness_max - brightness_min) / 2;
    const double brightness_mean = (brightness_max + brightness_min) / 2;

    int brightness = brightness_mean + brightness_amplitude * sin(2 * 3.14159 * led_pulse_freq * t);
    int led_msg_index = 0;

    const int mode_leds[] = { 2, 3 };
    const double color_auto[] = { 1, 0, 0 };
    const double color_manual[] = { 0, 1, 0 };
    const double color_cmd_vel[] = { 0, 0, 1 };
    const double color_unknown[] = { 0.33, 0.33, 0.33 };

    const int arm_leds[] = { 1, 4 };
    const double color_armed[] = { 1, 0, 0 };
    const double color_disarmed[] = { 0, 1, 0 };

    const double color_calibration[] = { 1, 1, 0 };

    const int headlight_leds[] = { 6, 7, 8, 9, 10, 11 };
    const double color_white[] = { 1, 1, 1 };

    // mode leds
    for (size_t i = 0; i < ARRAY_SIZE(mode_leds); i++) {
        const double* color = NULL;
        if (ctx->status.mode == synapse_msgs_Status_Mode_MODE_MANUAL) {
            color = color_manual;
        } else if (ctx->status.mode == synapse_msgs_Status_Mode_MODE_CMD_VEL) {
            color = color_cmd_vel;
        } else if (ctx->status.mode == synapse_msgs_Status_Mode_MODE_AUTO) {
            color = color_auto;
        } else if (ctx->status.mode == synapse_msgs_Status_Mode_MODE_CALIBRATION) {
            color = color_calibration;
        } else {
            color = color_unknown;
        }
        set_led(mode_leds[i], color, brightness, &ctx->led_array.led[led_msg_index]);
        led_msg_index++;
    }

    // arm leds
    for (size_t i = 0; i < ARRAY_SIZE(arm_leds); i++) {
        const double* color = NULL;

        if (ctx->status.arming == synapse_msgs_Status_Arming_ARMING_DISARMED) {
            color = color_disarmed;
        } else if (ctx->status.arming == synapse_msgs_Status_Arming_ARMING_ARMED) {
            color = color_armed;
        } else {
            color = color_unknown;
        }

        set_led(arm_leds[i], color, brightness, &ctx->led_array.led[led_msg_index]);
        led_msg_index++;
    }

    // headlight leds
    bool lights_on_requested = ctx->joy.buttons[JOY_BUTTON_LIGHTS_ON] == 1;
    bool lights_off_requested = ctx->joy.buttons[JOY_BUTTON_LIGHTS_OFF] == 1;

    if (lights_on_requested) {
        ctx->lights_on = true;
    } else if (lights_off_requested) {
        ctx->lights_on = false;
    }

    if (ctx->lights_on) {
        for (size_t i = 0; i < ARRAY_SIZE(headlight_leds); i++) {
            set_led(headlight_leds[i], color_white, 255, &ctx->led_array.led[led_msg_index]);
            led_msg_index++;
        }
    } else if (!ctx->lights_on) {
        for (size_t i = 0; i < ARRAY_SIZE(headlight_leds); i++) {
            set_led(headlight_leds[i], color_white, 0, &ctx->led_array.led[led_msg_index]);
            led_msg_index++;
        }
    }

    // set timestamp
    stamp_header(&ctx->led_array.header, k_uptime_ticks());
    ctx->led_array.header.seq++;
    ctx->led_array.led_count = led_msg_index;

    zros_pub_update(&ctx->pub_led_array);
}

static void lighting_timer_handler(struct k_timer* timer)
{
    context_t* ctx = CONTAINER_OF(timer, context_t, timer);
    k_work_submit_to_queue(&g_low_priority_work_q, &ctx->work_item);
}

static void lighting_entry_point(void* p0, void* p1, void* p2)
{
    LOG_INF("init");
    context_t* ctx = p0;
    ARG_UNUSED(p1);
    ARG_UNUSED(p2);

    lighting_init(ctx);
    k_timer_start(&ctx->timer, K_MSEC(33), K_MSEC(33));
}

K_THREAD_DEFINE(b3rb_lighting, MY_STACK_SIZE,
    lighting_entry_point, &g_ctx, NULL, NULL,
    MY_PRIORITY, 0, 1000);

/* vi: ts=4 sw=4 et */
```

## src/manual.c
```c
/*
 * Copyright CogniPilot Foundation 2023
 * SPDX-License-Identifier: Apache-2.0
 */

#include <zephyr/kernel.h>
#include <zephyr/logging/log.h>

#include <zros/private/zros_node_struct.h>
#include <zros/private/zros_pub_struct.h>
#include <zros/private/zros_sub_struct.h>
#include <zros/zros_node.h>
#include <zros/zros_pub.h>
#include <zros/zros_sub.h>

#include <synapse_topic_list.h>

#include "mixing.h"

#define MY_STACK_SIZE 1024
#define MY_PRIORITY 4

LOG_MODULE_REGISTER(b3rb_manual, CONFIG_CEREBRI_B3RB_LOG_LEVEL);

typedef struct _context {
    struct zros_node node;

    struct zros_sub sub_joy;
    struct zros_pub pub_actuators;

    synapse_msgs_Joy joy;
    synapse_msgs_Actuators actuators;

    const double wheel_radius;
    const double max_turn_angle;
    const double max_velocity;
} context;

static context g_ctx = {
    .node = {},
    .joy = synapse_msgs_Joy_init_default,
    .actuators = synapse_msgs_Actuators_init_default,
    .sub_joy = {},
    .pub_actuators = {},
    .wheel_radius = CONFIG_CEREBRI_B3RB_WHEEL_RADIUS_MM / 1000.0,
    .max_turn_angle = CONFIG_CEREBRI_B3RB_MAX_TURN_ANGLE_MRAD / 1000.0,
    .max_velocity = CONFIG_CEREBRI_B3RB_MAX_VELOCITY_MM_S / 1000.0,
};

static void init(context* ctx)
{
    zros_node_init(&ctx->node, "b3rb_manual");
    zros_sub_init(&ctx->sub_joy, &ctx->node, &topic_joy, &ctx->joy, 10);
    zros_pub_init(&ctx->pub_actuators, &ctx->node,
        &topic_actuators_manual, &ctx->actuators);
}

static void b3rb_manual_entry_point(void* p0, void* p1, void* p2)
{
    LOG_INF("init");
    context* ctx = p0;
    ARG_UNUSED(p1);
    ARG_UNUSED(p2);

    init(ctx);

    struct k_poll_event events[] = {
        *zros_sub_get_event(&ctx->sub_joy),
    };

    while (true) {
        // wait for joystick input event, publish at 1 Hz regardless

        k_poll(events, ARRAY_SIZE(events), K_MSEC(1000));

        if (zros_sub_update_available(&ctx->sub_joy)) {
            zros_sub_update(&ctx->sub_joy);
        }

        // compute turn_angle, and angular velocity from joystick
        double turn_angle = ctx->max_turn_angle * ctx->joy.axes[JOY_AXES_ROLL];
        double omega_fwd = ctx->max_velocity * ctx->joy.axes[JOY_AXES_THRUST] / ctx->wheel_radius;
        b3rb_set_actuators(&ctx->actuators, turn_angle, omega_fwd);

        zros_pub_update(&ctx->pub_actuators);
    }
}

K_THREAD_DEFINE(b3rb_manual, MY_STACK_SIZE,
    b3rb_manual_entry_point, (void*)&g_ctx, NULL, NULL,
    MY_PRIORITY, 0, 1000);

/* vi: ts=4 sw=4 et */
```

## src/movement.c
```c
//
//    Created by Enzo Le Van
//    Ce code récupère les différents actuators, ainsi que le status du rover : il envoie alors le bon actuator aux moteurs
//

#include "casadi/gen/b3rb.h"
#include "math.h"

#include <zephyr/logging/log.h>

#include <zros/private/zros_node_struct.h>
#include <zros/private/zros_pub_struct.h>
#include <zros/private/zros_sub_struct.h>
#include <zros/zros_node.h>
#include <zros/zros_pub.h>
#include <zros/zros_sub.h>

#include <cerebri/core/casadi.h>

#include "mixing.h"

#define MY_STACK_SIZE 3072
#define MY_PRIORITY 4

LOG_MODULE_REGISTER(b3rb_movement, CONFIG_CEREBRI_B3RB_LOG_LEVEL);

typedef struct _context {
    struct zros_node node;

    struct zros_sub sub_status, sub_actuators_manual, sub_actuators_auto;

    synapse_msgs_Status status;
    synapse_msgs_Actuators actuators;
    synapse_msgs_Actuators actuators_manual;
    synapse_msgs_Actuators actuators_auto;

    struct zros_pub pub_actuators;

    const double wheel_radius;
    const double wheel_base;
} context;

static context g_ctx = {
    .node = {},
    .status = synapse_msgs_Status_init_default,

    .sub_status = {},
    .sub_actuators_manual = {},
    .sub_actuators_auto = {},

    .actuators = synapse_msgs_Actuators_init_default,
    .actuators_manual = synapse_msgs_Actuators_init_default,
    .actuators_auto = synapse_msgs_Actuators_init_default,

    .pub_actuators = {},

    .wheel_radius = CONFIG_CEREBRI_B3RB_WHEEL_RADIUS_MM / 1000.0,
    .wheel_base = CONFIG_CEREBRI_B3RB_WHEEL_BASE_MM / 1000.0,
};

static void init(context* ctx)
{
    LOG_DBG("init movement");

    zros_node_init(&ctx->node, "b3rb_movement");
    zros_sub_init(&ctx->sub_status, &ctx->node, &topic_status, &ctx->status, 10);

    zros_sub_init(&ctx->sub_actuators_manual, &ctx->node,
        &topic_actuators_manual, &ctx->actuators_manual, 10);

    zros_sub_init(&ctx->sub_actuators_auto, &ctx->node,
        &topic_actuators_auto, &ctx->actuators_auto, 10);

    zros_pub_init(&ctx->pub_actuators, &ctx->node, &topic_actuators, &ctx->actuators);
}

static void stop(context* ctx)
{
    b3rb_set_actuators(&ctx->actuators, 0, 0);
}

static void b3rb_movement_entry_point(void* p0, void* p1, void* p2)
{
    LOG_INF("init");
    context* ctx = p0;
    ARG_UNUSED(p1);
    ARG_UNUSED(p2);

    init(ctx);

    struct k_poll_event events[] = {
        *zros_sub_get_event(&ctx->sub_status),
        *zros_sub_get_event(&ctx->sub_actuators_manual),
        *zros_sub_get_event(&ctx->sub_actuators_auto),
    };

    while (true) {
        k_poll(events, ARRAY_SIZE(events), K_MSEC(1000));

        if (zros_sub_update_available(&ctx->sub_status)) {
            zros_sub_update(&ctx->sub_status);
        }

        if (zros_sub_update_available(&ctx->sub_actuators_manual)) {
            zros_sub_update(&ctx->sub_actuators_manual);
        }

        if (zros_sub_update_available(&ctx->sub_actuators_auto)) {
            zros_sub_update(&ctx->sub_actuators_auto);
        }

        if (ctx->status.arming != synapse_msgs_Status_Arming_ARMING_ARMED) {
            stop(ctx);
            LOG_DBG("not armed, stopped");
        } else if (ctx->status.mode == synapse_msgs_Status_Mode_MODE_MANUAL) {
            LOG_DBG("manual mode");
            ctx->actuators = ctx->actuators_manual;
        } else if(ctx->status.mode == synapse_msgs_Status_Mode_MODE_AUTO){
            LOG_DBG("auto mode");
            ctx->actuators = ctx->actuators_auto;
        }

        // publish

        zros_pub_update(&ctx->pub_actuators);
    }
}

K_THREAD_DEFINE(b3rb_movement, MY_STACK_SIZE,
    b3rb_movement_entry_point, &g_ctx, NULL, NULL,
    MY_PRIORITY, 0, 1000);

/* vi: ts=4 sw=4 et */
```
